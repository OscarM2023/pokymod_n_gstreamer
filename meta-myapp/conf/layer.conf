## meta-python-scripts/conf/layer.conf
```bitbake
BBPATH .= ":${LAYERDIR}"
BBFILES += "${LAYERDIR}/recipes-*/*/*.bb ${LAYERDIR}/recipes-*/*/*.bbappend"

BBFILE_COLLECTIONS += "meta-python-scripts"
BBFILE_PATTERN_meta-python-scripts = "^${LAYERDIR}/"
BBFILE_PRIORITY_meta-python-scripts = "6"

LAYERSERIES_COMPAT_meta-python-scripts = "walnascar"
```
